## config/boards/arm/leptosis/Kconfig.board
```kconfig
# Copyright (c) 2025 The ZMK Contributors
# SPDX-License-Identifier: MIT

config BOARD_LEPTOSIS_LEFT
    bool "leptosis_left"
    depends on SOC_NRF52840_QIAA

config BOARD_LEPTOSIS_RIGHT
    bool "leptosis_right"
    depends on SOC_NRF52840_QIAA
```

## config/boards/arm/leptosis/Kconfig.defconfig
```kconfig
#
# Copyright (c) 2022 Cheyao
# SPDX-License-Identifier: MIT
#

if BOARD_LEPTOSIS_LEFT

config ZMK_KEYBOARD_NAME
    default "Leptosis"

config ZMK_SPLIT_ROLE_CENTRAL
    default y

endif # BOARD_LEPTOSIS_LEFT


if BOARD_LEPTOSIS_LEFT || BOARD_LEPTOSIS_RIGHT

config BOARD
    default "leptosis"

config ZMK_SPLIT
    default y

config BT_CTLR
    default BT

config I2C
	default y

config ZMK_MAX17048
	default y

if USB

config USB_NRFX
    default y

config USB_DEVICE_STACK
    default y

endif # USB

endif # BOARD_LEPTOSIS_LEFT || BOARD_LEPTOSIS_RIGHT
```

## config/west.yml
```yaml
manifest:
  remotes:
    - name: zmkfirmware
      url-base: https://github.com/zmkfirmware
    - name: cheyao
      url-base: https://github.com/cheyao
  projects:
    - name: zmk
      remote: zmkfirmware
      revision: main
      import: app/west.yml
  self:
    path: config
```
